## conf/layer.conf
```bitbake
# We have a conf and classes directory, add to BBPATH
BBPATH .= ":${LAYERDIR}"

# We have recipes-* directories, add to BBFILES
BBFILES += "${LAYERDIR}/recipes-*/*/*.bb \
            ${LAYERDIR}/recipes-*/*/*.bbappend"

BBFILE_COLLECTIONS += "meta-raspilab"
BBFILE_PATTERN_meta-raspilab = "^${LAYERDIR}/"
BBFILE_PRIORITY_meta-raspilab = "6"

LAYERDEPENDS_meta-raspilab = "core"
LAYERSERIES_COMPAT_meta-raspilab = "kirkstone"

DISTRO_FEATURES += "opengl security wayland keyboard systemd"
DISTRO_FEATURES_BACKFILL_CONSIDERED += "sysvinit"
INIT_MANAGER = "systemd"
```
